#pragma once

#include <SPI.h>
#include <Wire.h>
#include <Adafruit_GFX.h>
#include <Adafruit_SSD1306.h>
#include <ESPAsyncWebServer.h>

namespace DisplayAssets {
    const unsigned char epd_bitmap_cocktail [] PROGMEM = {
        0x00, 0x00, 0x00, 0x00, 0x00, 0x00, 0x00, 0x00, 0x00, 0x00, 0x00, 0x00, 0x00, 0x00, 0x00, 0x00, 
        0x00, 0x00, 0x00, 0x00, 0x00, 0x00, 0x00, 0x00, 0x00, 0x00, 0x00, 0x00, 0x00, 0x00, 0x00, 0x00, 
        0x00, 0x00, 0x00, 0x00, 0x00, 0x00, 0x00, 0x00, 0x00, 0x00, 0x00, 0x00, 0x00, 0x00, 0x00, 0x00, 
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        0x00, 0x00, 0x00, 0x00, 0x00, 0x00, 0x00, 0x00, 0x00, 0x00, 0x00, 0x00, 0x00, 0x00, 0x00, 0x00
    };
}

class DisplayManager {
public:
    static DisplayManager& getInstance() {
        static DisplayManager instance;
        return instance;
    }

    void begin() {
        if (!display.begin(SSD1306_SWITCHCAPVCC, SCREEN_ADDRESS)) {
            Serial.println(F("SSD1306 allocation failed"));
        }
        display.clearDisplay();
        display.setRotation(0);
        setImage();    
        display.display();
    }

    void setScreen(const String& first, const String& second, int size) {
        display.clearDisplay();
        display.setRotation(0);
        display.setTextSize(size);
        display.setTextColor(SSD1306_WHITE);
        display.setCursor(10, 10);
        display.println(first);
        display.setCursor(10, 40);
        display.println(second.c_str());
        display.display();
        delay(50);
    }

    void setImage() {
        display.clearDisplay();
        display.drawBitmap(
            (display.width()  - LOGO_WIDTH ) / 2,
            (display.height() - LOGO_HEIGHT) / 2,
            DisplayAssets::epd_bitmap_cocktail, LOGO_WIDTH, LOGO_HEIGHT, 1);
        display.display();
        delay(50);
    }



    void loop() {
        if (positionTmp == 500) {
            setImage();   
            positionTmp = 0;
        }
        else if (positionTmp == 1) {
            setScreen("Agua", "", 2);
            positionTmp += stop;
        }
        else if (positionTmp == 2) {
            setScreen("Cocacola", "", 2);
            positionTmp += stop;
        }
        else if (positionTmp == 3) {
            positionTmp = 1;
        }
    }

    void control(const String& direction) {
        if (direction == "back") {
             Serial.println("Has apretado back");
        }
        else if (direction == "up") {
             Serial.println("Has apretado arriba");
        }
        else if (direction == "next") {
             Serial.println("Has apretado siguiente: " + String(positionTmp));
             if (positionTmp != 0) {
                 positionTmp -= stop;
             }
             positionTmp++;
        }
        else if (direction == "down") {
             Serial.println("Has apretado abajo");
             if (positionTmp != 0) {
                 positionTmp = 500;
             }
        }
        else if (direction == "accept") {
             Serial.println("Has apretado aceptar");
        }
    }

private:
    const int SCREEN_WIDTH = 128;
    const int SCREEN_HEIGHT = 64;
    const int OLED_RESET = -1;
    const int SCREEN_ADDRESS = 0x3C;
    const int LOGO_HEIGHT = 64;
    const int LOGO_WIDTH = 128;

    Adafruit_SSD1306 display;

    int positionTmp = 0;
    const int stop = 500;

    DisplayManager() : display(SCREEN_WIDTH, SCREEN_HEIGHT, &Wire, OLED_RESET) {}

        if (direction == "back") {
             Serial.println("Has apretado back");
        }
        else if (direction == "up") {
             Serial.println("Has apretado arriba");
        }
        else if (direction == "next") {
             Serial.println("Has apretado siguiente: " + String(positionTmp));
             if (positionTmp != 0) {
                 positionTmp -= stop;
             }
             positionTmp++;
        }
        else if (direction == "down") {
             Serial.println("Has apretado abajo");
             if (positionTmp != 0) {
                 positionTmp = 500;
             }
        }
        else if (direction == "accept") {
             Serial.println("Has apretado aceptar");
        }
    }
};

inline void SetScreen(String first, String second, int size) {
    DisplayManager::getInstance().setScreen(first, second, size);
}

inline void StartDisplay() {
    DisplayManager::getInstance().begin();
}



inline void loopDisplay() {
    DisplayManager::getInstance().loop();
}
